## boards/shields/pskeeb5_v2/Kconfig.shield
```kconfig
# Copyright (c) 2020 Pete Johanson
# SPDX-License-Identifier: MIT

config SHIELD_PSKEEB5_V2_LEFT
    def_bool $(shields_list_contains,pskeeb5_v2_left)

config SHIELD_PSKEEB5_V2_RIGHT
    def_bool $(shields_list_contains,pskeeb5_v2_right) || \
             $(shields_list_contains,pskeeb5_v2_right_ydxc02)
```

## boards/shields/pskeeb5_v2/dts/bindings/zmk,behavior-mouse-speed.yaml
```yaml
description: Adjust trackpoint/mouse speed and report it to the peripheral display

compatible: "zmk,behavior-mouse-speed"

include: one_param.yaml
```
